/**
 * @cliArgs --device "F28002x" --package "80QFP" --part "F28002x_80QFP" --product "C2000WARE@3.01.00.00"
 * @versions {"tool":"1.11.0+2225"}
 */

/**
 * Import the modules used in this configuration.
 */
const epwm       = scripting.addModule("/driverlib/epwm.js", {}, false);
const epwm1      = epwm.addInstance();
const inputxbar  = scripting.addModule("/driverlib/inputxbar.js", {}, false);
const inputxbar1 = inputxbar.addInstance();
const sync       = scripting.addModule("/driverlib/sync.js");

/**
 * Write custom configuration values to the imported modules.
 */
epwm1.$name                  = "myEPWM0";
epwm1.useCase                = "CUSTOM";
epwm1.useInterfacePins       = ["EPWM#_B"];
epwm1.epwm.$assign           = "EPWM1";
epwm1.epwm.epwm_bPin.$assign = "ball.2";

inputxbar1.$name          = "myINPUTXBAR0";
inputxbar1.inputsUsed     = ["inputxbar5Gpio"];
inputxbar1.inputxbar5Gpio = "GPIO40";
